/*
 * Copyright (c) 2021 The ZMK Contributors
 *
 * SPDX-License-Identifier: MIT
 */

// #include <dt-bindings/zmk/matrix_transform.h>
#include "choctopus.dtsi"

/ {
    chosen {
        zmk,kscan = &kscan0;
    };

    kscan0: kscan_0 {
    compatible = "zmk";
    label = "KSCAN";
    diode-direction = "col2row";
    };
};

